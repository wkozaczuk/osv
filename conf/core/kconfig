## conf/core/kconfig
```kconfig
config core_alloc_tracker
  prompt "Include allocation tracker"
  bool
  default y

config core_c_wrappers
  prompt "Include C wrapper functions"
  bool
  default y

config core_callstack
  prompt "Include callstack"
  bool
  default y

config core_commands
  prompt "Include commands"
  bool
  default y

config core_dhcp
  prompt "Include dhcp"
  bool
  default y

config core_dynamic_percpu_size
  prompt "Dynamic per-CPU size"
  int
  default 65536

config core_epoll
  prompt "Include epoll"
  bool
  default y

config core_jvm_baloon
  prompt "Include JVM baloon"
  bool
  default n

config core_namespaces
  prompt "Include ELF namespaces"
  bool
  default y

config core_newpoll
  prompt "Include newpoll"
  bool
  default n

config core_poll
  prompt "Include poll"
  bool
  default y

config core_rcu_defer_queue_size
  prompt "RCU defer queue size"
  int
  default 2000

config core_sampler
  prompt "Include sampler"
  bool
  default y

config core_select
  prompt "Include select"
  bool
  default y

config core_strace
  prompt "Include strace"
  bool
  default y

config core_string_opt
  prompt "Include mem* and sse optimized versions"
  bool
  default y

config core_syscall
  prompt "Include syscall"
  bool
  default y

config core_tracepoints
  prompt "Include tracepoints"
  bool
  default y
```

## conf/drivers/kconfig
```kconfig
config driver_cadence
  prompt "Cadence Console"
  bool
  #depends on arch_aarch64
  default y

config driver_ahci
  prompt "AHCI"
  bool
  depends on arch_x86_64
  default y

config driver_pvscsi
  prompt "pvscsi"
  bool
  depends on (arch_x86_64 && scsi)
  default y

config driver_vmxnet
  prompt "vmxnet"
  bool
  depends on arch_x86_64
  default y

config driver_ena
  prompt "ena"
  bool
  depends on arch_x86_64
  default y
```

## conf/kconfig
```kconfig
mainmenu "OSv Configuration"

menu "Device Drivers"
  source "conf/drivers/kconfig"
endmenu

menu "Core Components"
  source "conf/core/kconfig"
endmenu

config preempt
  prompt "Enable preemption"
  def_bool $(shell,grep -q ^conf-preempt=1 conf/base.mk && echo y || echo n)

config tracing
  prompt "Enable code tracing"
  def_bool $(shell,grep -q ^conf-tracing=1 conf/base.mk && echo y || echo n)

config debug_memory
  prompt "Enable memory debugging"
  def_bool $(shell,grep -q ^conf-debug_memory=1 conf/base.mk && echo y || echo n)

config logger_debug
  prompt "Enable debug logger"
  def_bool $(shell,grep -q ^conf-logger_debug=1 conf/base.mk && echo y || echo n)

config hide_symbols
  prompt "Hide non-libc symbols"
  def_bool $(shell,grep -q ^conf_hide_symbols=1 conf/base.mk && echo y || echo n)

config lazy_stack
  prompt "Use lazy stack"
  def_bool $(shell,grep -q ^conf-lazy_stack=1 conf/base.mk && echo y || echo n)

choice
  prompt "Select image filesystem"
  default fs_zfs

config fs_zfs
  bool "Zeta File System"
config fs_rofs
  bool "Read-Only File System"
config fs_rofs_with_zfs
  bool "RoFS with ZFS"
config fs_ramfs
  bool "RAM FS"
config fs_virtiofs
  bool "Virtio FS"

endchoice
```
